## build/meta-litetv/conf/distro/litetv.conf
```bitbake
# LiteTV OS distro — lean Wayland appliance (no X11, minimal init).
# Targets: image < 2.5 GB, RAM <= 512 MB (see docs/06, docs/13).
require conf/distro/poky.conf

DISTRO = "litetv"
DISTRO_NAME = "LiteTV OS"
DISTRO_VERSION = "0.1.0"
DISTRO_CODENAME = "aurora"
MAINTAINER = "LiteTV OS"

# Wayland-only graphics; drop X11 and other bulk.
DISTRO_FEATURES:append = " wayland opengl"
DISTRO_FEATURES:remove = "x11 wayland-x11 nfs"

# Small, fast init. (Switch to systemd only if a feature needs it.)
INIT_MANAGER = "sysvinit"
VIRTUAL-RUNTIME_init_manager = "busybox"

# Size discipline.
DISTRO_FEATURES:remove = "ptest"
INHERIT += "rm_work"
```

## build/meta-litetv/conf/layer.conf
```bitbake
# meta-litetv — LiteTV OS Yocto layer
BBPATH .= ":${LAYERDIR}"
BBFILES += "${LAYERDIR}/recipes-*/*/*.bb ${LAYERDIR}/recipes-*/*/*.bbappend"

BBFILE_COLLECTIONS += "litetv"
BBFILE_PATTERN_litetv = "^${LAYERDIR}/"
BBFILE_PRIORITY_litetv = "10"

LAYERDEPENDS_litetv = "core"
LAYERSERIES_COMPAT_litetv = "nanbield scarthgap styhead"
```

## build/meta-litetv/conf/machine/litetv-qemuarm64.conf
```bitbake
#@TYPE: Machine
#@NAME: litetv-qemuarm64
#@DESCRIPTION: LiteTV OS reference QEMU aarch64 target (virtual-first bring-up).
require conf/machine/qemuarm64.conf

# Headless-capable virtio-gpu; KMS/DRM path matches the real overlay-plane model.
XSERVER = ""
PREFERRED_PROVIDER_virtual/libgl ?= "mesa"
MACHINE_FEATURES:append = " vfat"

# Give QEMU enough RAM to validate the 512 MB budget with headroom.
QB_MEM = "-m 1024"
QB_GRAPHICS = "-device virtio-gpu-pci"
QB_AUDIO_DRV = "none"
```
